## boards/shields/moNa2/Kconfig.defconfig
```kconfig
if SHIELD_MONA2_R

    config ZMK_KEYBOARD_NAME
        default "moNa2_R"

    config ZMK_SPLIT
        default y

    config ZMK_SPLIT_ROLE_CENTRAL
        default y

    # Fix for prospector scanner
    if ZMK_STATUS_ADVERTISEMENT
        config MIPI_DBI
        bool
    endif

endif

if SHIELD_MONA2_L

    config ZMK_KEYBOARD_NAME
        default "moNa2_L"

    config ZMK_SPLIT
        default y

endif
```

## config/boards/shields/Test/Kconfig.shield
```kconfig
config SHIELD_moNa2_R
    def_bool $(shields_list_contains,moNa2_R)

config SHIELD_moNa2_L
    def_bool $(shields_list_contains,moNa2_L)
```

## config/west.yml
```yaml
manifest:
  remotes:
    - name: zmkfirmware
      url-base: https://github.com/zmkfirmware
    - name: sayu-hub
      url-base: https://github.com/sayu-hub
    - name: caksoylar  # <-- new entry
      url-base: https://github.com/caksoylar
    - name: badjeff
      url-base: https://github.com/badjeff
  projects:
    - name: zmk
      remote: zmkfirmware
      revision: main
      import: app/west.yml
    # - name: zmk-pmw3610-driver
    #   remote: sayu-hub
    #   revision: main
    #   path: modules/zmk-pmw3610-driver-sayu-hub
    - name: zmk-pmw3610-driver
      remote: badjeff
      revision: main
      path: modules/zmk-pmw3610-driver-badjeff
    - name: zmk-rgbled-widget  # <-- new entry
      remote: caksoylar
      revision: main
      path: modules/zmk-rgbled-widget
  self:
    path: config
```
