## config/west.yml
```yaml
manifest:
  remotes:
    - name: zmkfirmware
      url-base: https://github.com/zmkfirmware
    - name: inorichi
      url-base: https://github.com/inorichi
    - name: caksoylar
      url-base: https://github.com/caksoylar
    - name: badjeff
      url-base: https://github.com/badjeff
    - name: urob
      url-base: https://github.com/urob
    - name: ssbb
      url-base: https://github.com/ssbb
    - name: sekigon-gonnoc
      url-base: https://github.com/sekigon-gonnoc
    - name: 4mplelab
      url-base: https://github.com/4mplelab
    - name: kot149
      url-base: https://github.com/kot149
    - name: te9no
      url-base: https://github.com/te9no
  projects:
    # https://github.com/sekigon-gonnoc/zmk/tree/v0.4+nemu-link
    - name: zmk
      remote: sekigon-gonnoc
      revision: c2db9b12bf20b8cb7e938fe414d3347ed55a21a1 # v0.4+nemu-link
      import: app/west.yml

    - name: zmk-feature-nemu-link
      remote: sekigon-gonnoc
      revision: c9e735b170e77c34744113473d4889ffb96be8af # zmk-v0.4
      path: modules/zmk-feature-nemu-link
      import: config/west.yml

    # https://github.com/sekigon-gonnoc/zmk-driver-paw3222
    - name: zmk-driver-paw3222
      remote: sekigon-gonnoc
      revision: df652881be2520bde4f64ab6ca35e4c5708f4f9b # main (2026-11-03)
      path: modules/zmk-driver-paw3222

    # https://github.com/badjeff/zmk-input-processor-report-rate-limit
    - name: zmk-input-processor-report-rate-limit
      remote: badjeff
      revision: b056cb135525933743e2627150fb390f9d4b2461 # main (2026-11-15)
      path: modules/zmk-input-processor-report-rate-limit

    # https://github.com/ssbb/zmk-listeners
    - name: zmk-listeners
      remote: ssbb
      revision: c240ceaf353d3138bea7695eef17049b7ade995b # v1 (2026-11-03)
      path: modules/zmk-listeners

    # https://github.com/caksoylar/zmk-smart-toggle.git
    - name: zmk-smart-toggle
      remote: caksoylar
      revision: 46e178221cccef965a511b772d7bc62800f1542e # v0.3-branch (2026-11-03)
      path: modules/zmk-smart-toggle

    # https://github.com/urob/zmk-adaptive-key
    - name: zmk-adaptive-key
      remote: urob
      revision: 01ccc22889714f276c930dc960a989f80c9e0680 # v0.3
      path: modules/zmk-adaptive-key

    # https://github.com/caksoylar/zmk-rgbled-widget
    - name: zmk-rgbled-widget
      remote: caksoylar
      revision: e6b467792a1dabef8cfa5c9fd26bfefc9c16662b # main (2026-11-15)
      path: modules/zmk-rgbled-widget

    # https://github.com/4mplelab/zmk-feature-charge-indicator.git
    - name: zmk-feature-charge-indicator
      remote: 4mplelab
      revision: f0d311ed7804cda0e5837ef902f0419aeace4a88 # main (2026-11-03)
      path: modules/zmk-feature-charge-indicator

    # https://github.com/kot149/zmk-feature-fixed-locality
    - name: zmk-feature-fixed-locality
      remote: kot149
      revision: e35179e2b307ab4c77b99fd618e9e9278c19cdf8 # main
      path: modules/zmk-feature-fixed-locality

    # https://github.com/kot149/zmk-mouse-gesture
    - name: zmk-mouse-gesture
      remote: kot149
      revision: 027bf5ecd413010a1f3cbd66ccc7ce28b3096b8f # v2-deferred-exec
      path: modules/zmk-mouse-gesture

    # https://github.com/kot149/zmk-layout-shift
    - name: zmk-layout-shift
      remote: kot149
      revision: f9ea0302d2796b4dd2f8932cf8f2979bb2d8a558 # v2 (2026-11-15)
      path: modules/zmk-layout-shift

    # https://github.com/kot149/zmk-scroll-snap
    - name: zmk-scroll-snap
      remote: kot149
      revision: 6b2dccaab2d5b99ca8b79300b9a792fefb01c42d # v1 (2026-11-21)
      path: modules/zmk-scroll-snap

    # https://github.com/te9no/zmk-feature-blueboot
    - name: zmk-feature-blueboot
      remote: te9no
      revision: f099518bce4d7d5a06e60ff9ad7e8d66954286ae # main (2026-11-03)
      path: modules/zmk-feature-blueboot

  self:
    path: config
```
